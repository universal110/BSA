## CMakeLists.txt
```
#-------------------------------------------------------------------------------
# Zephyr Example Application
#
# Copyright (c) 2021 Nordic Semiconductor ASA
# SPDX-License-Identifier: Apache-2.0

cmake_minimum_required(VERSION 3.13.1)
find_package(Zephyr REQUIRED HINTS $ENV{ZEPHYR_BASE})

project(app LANGUAGES C)

zephyr_include_directories(src)
zephyr_include_directories(src/devices)

target_sources(app PRIVATE
    src/main.c
    src/motionTracker.c
    src/sensor.c
)
```

## prj.conf
```kconfig
# Copyright (c) 2021 Nordic Semiconductor ASA
# SPDX-License-Identifier: Apache-2.0
#
# This file contains selected Kconfig options for the application.

CONFIG_GPIO=y
#CONFIG_PWM=y
CONFIG_SMF=y

CONFIG_I2C=y
CONFIG_FPU=y
```

## src/main.c
```c
#include <zephyr/kernel.h> 
#include <zephyr/sys/printk.h>
#include "BTN.h"
#include "motionTrackerInterface.h"
#include "sensor.h"

#define SLEEP_MS 1

int main(void) {

    k_msleep(3000);
    int rv = motionTrackerInit();
    if (0 > rv) {
        printk("Motion tracker initialization failed\n");
        return 0;
    }

    // tracks the last time an event was recorded
    // prevents one flick from recording multiple events
    int64_t lastEventTime = 0;

    while (1) {

        // start a new session, records baseline orientation
        if (BTN_check_clear_pressed(BTN0)) {
            startMotionSessions();
        }

        // automatic motion detection which replaces BTN1
        // reads total accelerometer force and records event
        // if it exceeds threshold and cooldown has passed
        if (motionTrackerIsActive()) {
            float magnitude = sensorGetMagnitude();
            int64_t now = k_uptime_get();

            // threshold 
            if (magnitude > 28000.0f && (now - lastEventTime) > 500) {
                recordMotionEvents();
                lastEventTime = now;
            }
        }

        // BTN2: end the session and print all metrics
        if (BTN_check_clear_pressed(BTN2)) {
            endMotionSession();
        }

        k_msleep(SLEEP_MS);
    }

    return 0;
}
```

## src/motionTracker.c
```c
#include <zephyr/kernel.h>
#include <zephyr/sys/printk.h>
#include "motionTrackerInterface.h"
#include "BTN.h"
#include "sensor.h"

static void motionTrackerPrintResults(void);


static struct eventSession currentSession;
static bool sessionActive = false;
static float wrist_roll = 0.0f;   // wrist rotating as ball is released
static float wrist_snap = 0.0f;   // wrist snapping forward on follow through


// the following function sets the buttons to detect presses or input and creates a clean session
int motionTrackerInit(){
    int btn = BTN_init();
    if (0 > btn) {
        printk("initialization failed\n");
        return btn;      
    }

    int sens = sensorInit();
    if (0 > sens){
        printk("sensor start failed\n");
        return sens;
    }

    currentSession.eventCounter = 0;
    currentSession.sessionStartTimestamp = 0;
    currentSession.sessionEndTimestamp = 0;

    for (int i = 0; i < MAX_EVENTS; i++){
        currentSession.motionEvents[i].eventidx = 0;
        currentSession.motionEvents[i].timestamp = 0;
    }
  
    printk("motion tracker ready\n");
    return 0;
    
}

void startMotionSessions(void) {
    sessionActive = true;

    wrist_roll = sensorWristTurn();
    wrist_snap = sensorWristBend();

    currentSession.sessionStartTimestamp = k_uptime_get();
    currentSession.eventCounter = 0;
    printk("Session started\n");


}

void endMotionSession(void){
    sessionActive = false;
    currentSession.sessionEndTimestamp = k_uptime_get();
    printk("Session ended\n");
    motionTrackerPrintResults();
    
}

void recordMotionEvents(void){
    if (!sessionActive) {
      printk("No active session\n");
      return;
    }
    if(currentSession.eventCounter == MAX_EVENTS){
      printk("Max Events Reached\n");
      return;
    }

    int64_t currTime = k_uptime_get();

    currentSession.motionEvents[currentSession.eventCounter].timestamp = currTime;
    currentSession.motionEvents[currentSession.eventCounter].eventidx = currentSession.eventCounter;
    
    // Store lateral (left/right) and forward deviation separately
    float currentTurn = sensorWristTurn();
    float currentBend = sensorWristBend();

    currentSession.motionEvents[currentSession.eventCounter].lateralDeviation = currentTurn - wrist_roll;

    currentSession.motionEvents[currentSession.eventCounter].forwardDeviation = currentBend - wrist_snap;

    currentSession.eventCounter += 1;
    printk("Event %d recorded at %lld ms\n", currentSession.eventCounter, currTime);



}

static void motionTrackerPrintResults(void){

    printk("Total events: %d\n", currentSession.eventCounter);

    if (2 > currentSession.eventCounter){
        printk("not enough data\n");
        return;
    }

    int64_t reactionTime = currentSession.motionEvents[0].timestamp - currentSession.sessionStartTimestamp;

    int64_t intervals[MAX_EVENTS];
    int64_t totalInterval = 0;
    int64_t avgIntervals = 0;
    int64_t numIntervals = 0;

    for (int i = 1; i < currentSession.eventCounter; i++){
        intervals[i - 1] = currentSession.motionEvents[i].timestamp - currentSession.motionEvents[i - 1].timestamp;
        totalInterval += intervals[i - 1];
    }

    numIntervals = currentSession.eventCounter - 1;
    avgIntervals = totalInterval / numIntervals;

    int64_t varianceSum = 0;
    for (int i = 0; i < numIntervals; i++) {
        int64_t difference = intervals[i] - avgIntervals;
        varianceSum += difference * difference;
    }
    int64_t variance = varianceSum / numIntervals;

    // Per shot breakdown
    printk("--- Shot Analysis ---\n");

    int64_t totalLateral = 0;
    int64_t totalForward = 0;

    for (int i = 0; i < currentSession.eventCounter; i++) {

        float lat = currentSession.motionEvents[i].lateralDeviation;
        float fwd = currentSession.motionEvents[i].forwardDeviation;

        // absolute value — negative just means left vs right direction
        if (lat < 0) lat = -lat;
        if (fwd < 0) fwd = -fwd;

        int latWhole   = (int)lat;
        int latDecimal = (int)((lat - latWhole) * 100);
        int fwdWhole   = (int)fwd;
        int fwdDecimal = (int)((fwd - fwdWhole) * 100);

        const char *label;
        if (lat < 5.0f) {
            label = "Straight release";
        } else if (lat < 15.0f) {
            label = "Slight deviation";
        } else {
            label = "Significant deviation";
        }

        printk("Shot %d - Lateral: %d.%02d  Forward: %d.%02d — %s\n",
               currentSession.motionEvents[i].eventidx + 1,
               latWhole, latDecimal,
               fwdWhole, fwdDecimal,
               label);

        totalLateral += (int64_t)lat;
        totalForward += (int64_t)fwd;
    }

    // Session summary
    int64_t avgLateral = totalLateral / currentSession.eventCounter;
    int64_t avgForward = totalForward / currentSession.eventCounter;

    const char *overallLabel;
    if (avgLateral < 5) {
        overallLabel = "Straight release";
    } else if (avgLateral < 15) {
        overallLabel = "Slight deviation";
    } else {
        overallLabel = "Significant deviation";
    }

    printk("--- Session Summary ---\n");
    printk("Total shots: %d\n", currentSession.eventCounter);
    printk("Reaction time: %lld ms\n", reactionTime);
    printk("Avg interval: %lld ms\n", avgIntervals);
    printk("Avg lateral deviation: %lld degrees\n", avgLateral);
    printk("Avg forward deviation: %lld degrees\n", avgForward);
    printk("Overall release: %s\n", overallLabel);
    printk("Consistency: ");
    if (variance < 2000) {
        printk("HIGH\n");
    } else if (variance < 8000) {
        printk("MEDIUM\n");
    } else {
        printk("LOW\n");
    }
}

bool motionTrackerIsActive(void) {
    return sessionActive;
}
```

## src/motionTrackerInterface.h
```c
#ifndef MOTION_TRACKER_INTERFACE_H
#define MOTION_TRACKER_INTERFACE_H


#include <zephyr/kernel.h>
#include <stdint.h>

#define MAX_EVENTS 20 // number of events displayed and tracked 
struct eventTracker {
    int eventidx;
    int64_t timestamp;
    //int64_t wristDeviation;
    float lateralDeviation;   // left/right wrist movement
    float forwardDeviation;   // wrist snap forward
};

struct eventSession {
    struct eventTracker motionEvents[MAX_EVENTS];
    int eventCounter;
    int64_t sessionStartTimestamp;
    int64_t sessionEndTimestamp;
};


int motionTrackerInit(void);
void startMotionSessions(void);
void endMotionSession(void);
void recordMotionEvents(void);
bool motionTrackerIsActive(void);


#endif
```

## src/sensor.c
```c
#include <zephyr/kernel.h>
#include <zephyr/drivers/i2c.h>
#include <math.h>
#include "sensor.h"
#include <zephyr/sys/printk.h>

static const struct device *i2c_dev = DEVICE_DT_GET(DT_NODELABEL(i2c0));



int sensorInit(void) {

    if (!device_is_ready(i2c_dev)) {
        printk("I2C device not ready\n");
        return -EIO;
    }

    // i2c_configure() sets up the I2C bus with specific settings.

    int rv = i2c_configure(i2c_dev, I2C_MODE_CONTROLLER | I2C_SPEED_SET(I2C_SPEED_FAST));
    if (rv < 0) {
        printk("I2C configuration failed\n");
        return rv;
    }

    // The MPU-6050 starts in sleep mode by default to save power.
    // We must wake it up before it will respond to any read requests.
    // i2c_reg_write_byte() writes a single byte to a specific register.
    // It takes four arguments:
    //   - the I2C device handle
    //   - the sensor's I2C address (0x68)
    //   - the register to write to (0x6B = power management register)
    //   - the value to write (0x00 = clear all bits = wake up)
    // Writing 0x00 to register 0x6B clears the sleep bit inside the sensor
    rv = i2c_reg_write_byte(i2c_dev, sensor_ADDR, sensor_PWR_MGMT, 0x00);
    if (rv < 0) {
        printk("Failed to wake MPU-6050\n");
        return rv;
    }

    k_msleep(100);

    printk("Sensor ready\n");
    return 0;
}


static int sensorReadAccel(int16_t *x, int16_t *y, int16_t *z) {

    // A buffer to hold the 6 raw bytes coming back from the sensor.
    // The accelerometer gives 2 bytes per axis (X, Y, Z) = 6 bytes total.

    uint8_t buf[6];

    int rv = i2c_burst_read(i2c_dev, sensor_ADDR, sensor_ACCEL_XOUT_H, buf, 6);
    if (rv < 0) {
        printk("Failed to read accelerometer\n");
        return rv;
    }

    uint8_t  x_high    = buf[0];             
    uint8_t  x_low     = buf[1];             
    uint16_t x_shifted = x_high * 256;       
                                             
                                             
    int16_t  x_final   = x_shifted + x_low; 
    *x = x_final;                            

    uint8_t  y_high    = buf[2];
    uint8_t  y_low     = buf[3];
    uint16_t y_shifted = y_high * 256;
    int16_t  y_final   = y_shifted + y_low;
    *y = y_final;


    uint8_t  z_high    = buf[4];
    uint8_t  z_low     = buf[5];
    uint16_t z_shifted = z_high * 256;
    int16_t  z_final   = z_shifted + z_low;
    *z = z_final;

    return 0;
}



float sensorWristBend(void) {

    int16_t ax, ay, az;
    int rv = sensorReadAccel(&ax, &ay, &az);
    if (rv < 0) {

        return 0.0f;
    }

    float wristBend = atan2f((float)ay, (float)az) * (180.0f / (3.14159265f));

    return wristBend;
}


float sensorWristTurn(void) {

    // Same read pattern as sensorWristBend()
    int16_t ax, ay, az;
    int rv = sensorReadAccel(&ax, &ay, &az);
    if (rv < 0) {
        return 0.0f;
    }

    // For roll (wrist turn) we compare X axis to Z axis instead of Y to Z
    // Everything else is identical to the pitch calculation above
    float wristTurn = atan2f((float)ax, (float)az) * (180.0f / 3.14159265f);

    return wristTurn;
}



float sensorGetDeviation(float sidewaysTilt, float wristBend) {

    // Get the current wrist orientation from the sensor
    float currentTurn = sensorWristTurn();
    float currentBend = sensorWristBend();

    // Calculate how much each angle changed from the baseline
    // sidewaysTilt is the baseline_roll recorded at session start
    // wristBend is the baseline_pitch recorded at session start
    float diffTurn = currentTurn - sidewaysTilt;
    float diffBend = currentBend - wristBend;

    float deviation = sqrtf((diffTurn * diffTurn) + (diffBend * diffBend));

    return deviation;
}

float sensorGetMagnitude(void) {

    // Read raw accelerometer values
    int16_t ax, ay, az;
    int rv = sensorReadAccel(&ax, &ay, &az);
    if (rv < 0) {
        return 0.0f;
    }

    // Calculate total force across all three axes
    // When still this is ~16384 (just gravity)
    // A wrist flick spikes this significantly higher
    float magnitude = sqrtf(((float)ax * (float)ax) +
                            ((float)ay * (float)ay) +
                            ((float)az * (float)az));
    return magnitude;
}
```

## src/sensor.h
```c
#ifndef SENSOR_H
#define SENSOR_H


#include <zephyr/kernel.h>
#include <zephyr/drivers/i2c.h>

#define sensor_ADDR      0x68

#define sensor_PWR_MGMT  0x6B


#define sensor_ACCEL_XOUT_H 0x3B  
#define sensor_ACCEL_XOUT_L 0x3C  
#define sensor_ACCEL_YOUT_H 0x3D 
#define sensor_ACCEL_YOUT_L 0x3E 

#define sensor_GYRO_XOUT_H 0x43 
#define sensor_GYRO_XOUT_L 0x44  
#define sensor_GYRO_YOUT_H 0x45
#define sensor_GYRO_YOUT_L 0x46  

int sensorInit(void);
float sensorWristTurn(void); // sensor roll
float sensorWristBend(void); // sensor pitch
float sensorGetDeviation(float sidewaysTilt, float wristBend);
float sensorGetMagnitude(void);


#endif
```
